## Documentation/devicetree/bindings/iio/temperature/as6200.txt
```
ams AG AS6200 temperature sensor driver

Required properties:
	- compatible: must be "ams,as6200"
	- reg: I2C 7-bit address for the device
		possible values: 0x48, 0x49, 0x4a, 0x4b
	- interrupt-parent: should be the phandle for the interrupt controller
	- interrupts: the sole interrupt generated by the device

	Refer to interrupt-controller/interrupts.txt for generic
	interrupt client node bindings.

Example:

as6200@0x4b {
	compatible = "ams,as6200";
	reg = <0x4b>;
	interrupt-parent = <&gpio>;
	interrupts = <4 1>;
};
```
